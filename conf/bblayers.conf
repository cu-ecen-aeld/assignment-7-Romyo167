## conf/bblayers.conf
```bitbake
# POKY_BBLAYERS_CONF_VERSION is increased each time build/conf/bblayers.conf
# changes incompatibly
POKY_BBLAYERS_CONF_VERSION = "2"

BBPATH = "${TOPDIR}"
BBFILES ?= ""

BBLAYERS ?= " \
  /home/rnosir/embedded-inux-course-2/assignment-3/assignments-3-and-later-Romyo167/poky/meta \
  /home/rnosir/embedded-inux-course-2/assignment-3/assignments-3-and-later-Romyo167/poky/meta-poky \
  /home/rnosir/embedded-inux-course-2/assignment-3/assignments-3-and-later-Romyo167/poky/meta-yocto-bsp \
  "
```
